// SPDX-License-Identifier: GPL-2.0 OR X11
/*
 * Copyright 2015 Boundary Devices, Inc.
 * Copyright 2021 Logos Payment Solutions A/S
 */

/dts-v1/;

#include "imx6dl.dtsi"
#include "imx6qdl-nicore8.dtsi"

/ {
	model = "Logos i.MX6 Solo NiCore8 Board";
	compatible = "logos,imx6dl-nicore8","fsl,imx6dl";
};
